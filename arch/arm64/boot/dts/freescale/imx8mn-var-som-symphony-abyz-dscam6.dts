// SPDX-License-Identifier: (GPL-2.0+ OR MIT)
/*
 * Copyright 2019 NXP
 * Copyright 2020-2021 Variscite Ltd.
 */

#include "imx8mn-var-som-symphony.dts"
#include "imx8mn-var-som-symphony-abyz-dscam6.dtsi"
/ {
	model = "Variscite DART-MX8M-PLUS on Sympony with H&Abyz Xray detector";
};


