// SPDX-License-Identifier: (GPL-2.0+ OR MIT)
/*
 * Copyright 2019 NXP
 * Copyright 2020-2021 Variscite Ltd.
 */

#include "imx8mp-var-som-symphony.dts"
#include "imx8mp-var-som-symphony-abyz-dscam6-reinstall.dtsi"
/ {
	model = "Variscite DART-MX8M-PLUS on Sympony with H&Abyz Xray detector( DSCAM6_NOT_USED)";
};


